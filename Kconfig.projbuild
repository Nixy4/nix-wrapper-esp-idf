## Kconfig.projbuild
```kconfig
menu "Wrapper-ESP32"
    choice WRAPPER_ESP32_BOARD
        prompt "Select Wrapper-ESP32 board"
        default WRAPPER_ESP32_BOARD_CUSTOM
        config WRAPPER_ESP32_BOARD_CUSTOM
            bool "Custom board"
        config WRAPPER_ESP32_BOARD_M5STACK_CORE_S3
            bool "M5Stack Core S3"
            depends on IDF_TARGET_ESP32S3
        config WRAPPER_ESP32_BOARD_M5STACK_CARDPUTER
            bool "M5Stack Cardputer"
            depends on IDF_TARGET_ESP32S3
        config WRAPPER_ESP32_BOARD_M5STACK_TAB5
            bool "M5Stack Tab5"
            depends on IDF_TARGET_ESP32P4
        config WRAPPER_ESP32_BOARD_LILYGO_T_LORA_PAGER
            bool "LilyGo T-LoraPager"
            depends on IDF_TARGET_ESP32S3
    endchoice
endmenu
```
